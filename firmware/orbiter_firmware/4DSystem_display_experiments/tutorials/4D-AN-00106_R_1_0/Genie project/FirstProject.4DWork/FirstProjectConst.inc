// File generated 27.02.2019 22:12:11
// Warning! This is a generated file, any manual changes will be
// lost during the next generation.

// object indexes into ImageControl
#CONST
    iUserled0       // offset 0x0
    iUserled1       // offset 0x1A00
    iUserled2       // offset 0x3400
    iUserled3       // offset 0x4E00
    iUserled4       // offset 0x6800
    iUserled5       // offset 0x8200
    iUserled6       // offset 0x9C00
    iUserled7       // offset 0xB600
    iUserled8       // offset 0xD000
    iUserled9       // offset 0xEA00
    iUserled10      // offset 0x10400
    iUserled11      // offset 0x11E00
    iUserled12      // offset 0x13800
    iUserled13      // offset 0x15200
    iUserled14      // offset 0x16C00
    iUserled15      // offset 0x18600
    iUserled16      // offset 0x1A000
    iUserled17      // offset 0x1BA00
    iUserled18      // offset 0x1D400
    iUserled19      // offset 0x1EE00
    iUserled20      // offset 0x20800
    iUserled21      // offset 0x22200
    iUserled22      // offset 0x23C00
    iUserled23      // offset 0x25600
    iUserled24      // offset 0x27000
    iUserled25      // offset 0x28A00
    iUserled26      // offset 0x2A400
    iUserled27      // offset 0x2BE00
    iUserled28      // offset 0x2D800
    iUserled29      // offset 0x2F200
    iUserled30      // offset 0x30C00
    iUserled31      // offset 0x32600
    iUserled32      // offset 0x34000
    iUserled33      // offset 0x35A00
    iUserled34      // offset 0x37400
    iUserled35      // offset 0x38E00
    iUserled36      // offset 0x3A800
    iUserled37      // offset 0x3C200
    iUserled38      // offset 0x3DC00
    iUserled39      // offset 0x3F600
    iUserled40      // offset 0x41000
    iUserled41      // offset 0x42A00
    iUserled42      // offset 0x44400
    iUserled43      // offset 0x45E00
    iUserled44      // offset 0x47800
    iUserled45      // offset 0x49200
    iUserled46      // offset 0x4AC00
    iUserled47      // offset 0x4C600
    iUserled48      // offset 0x4E000
    iUserled49      // offset 0x4FA00
    iUserled50      // offset 0x51400
    iUserled51      // offset 0x52E00
    iUserled52      // offset 0x54800
    iUserled53      // offset 0x56200
    iUserled54      // offset 0x57C00
    iUserled55      // offset 0x59600
    iUserled56      // offset 0x5B000
    iUserled57      // offset 0x5CA00
    iUserled58      // offset 0x5E400
    iUserled59      // offset 0x5FE00
    iUserled60      // offset 0x61800
    iUserled61      // offset 0x63200
    iUserled62      // offset 0x64C00
    iUserled63      // offset 0x66600
    iUserled64      // offset 0x68000
    iUserled65      // offset 0x69A00
    iUserled66      // offset 0x6B400
    iUserled67      // offset 0x6CE00
    iUserled68      // offset 0x6E800
    iUserled69      // offset 0x70200
    iUserled70      // offset 0x71C00
    iUserled71      // offset 0x73600
    iUserled72      // offset 0x75000
    iUserled73      // offset 0x76A00
    iUserled74      // offset 0x78400
    iUserled75      // offset 0x79E00
    iUserled76      // offset 0x7B800
    iUserled77      // offset 0x7D200
    iUserled78      // offset 0x7EC00
    iUserled79      // offset 0x80600
#END

#IFNOT EXISTS NOGLOBALS
var hndl ;
#ENDIF
